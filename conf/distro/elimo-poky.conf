## conf/distro/elimo-poky.conf
```bitbake
require conf/distro/poky.conf

DISTRO = "elimo-poky"
DISTRO_NAME = "Elimo Poky (Elimo Engineering Reference Distro)"
DISTRO_VERSION = "1.0"
SDK_VENDOR = "-pokysdk"
SDK_VERSION = "${@d.getVar('DISTRO_VERSION').replace('snapshot-${METADATA_REVISION}', 'snapshot')}"
SDK_VERSION[vardepvalue] = "${SDK_VERSION}"

MAINTAINER = "Matteo Scordino <matteo@elimo.io>"

TARGET_VENDOR = "-poky"

LOCALCONF_VERSION = "2"

PACKAGE_CLASSES ?= "package_deb"


DISTRO_FEATURES += "debug-tweaks package-management"

PREFERRED_VERSION_linux-mainline="6.0.1"

CORE_IMAGE_EXTRA_INSTALL += " xf86-video-fbdev"                                                                                                                                                                
CORE_IMAGE_EXTRA_INSTALL += " linux-firmware"                                                                                                                                                                  
CORE_IMAGE_EXTRA_INSTALL += " connman"                                                                                                                                                                         
CORE_IMAGE_EXTRA_INSTALL += " bluez5"
CORE_IMAGE_EXTRA_INSTALL += " i2c-tools"                                                                                                                                                                       
CORE_IMAGE_EXTRA_INSTALL += " ${TOUCHSCREEN_UTILS}"                                                                                                                                                            
#CORE_IMAGE_EXTRA_INSTALL += " ${VIDEO_TOOLS}"                                                                                                                                                                 
                                                                                                                                                                                                               
#CORE_IMAGE_EXTRA_INSTALL += "wayland weston"                                                                                                                                                                  
                                                                                                                                                                                                               
TOUCHSCREEN_UTILS = " \                                                                                                                                                                                        
    evtest \                                                                                                                                                                                                   
    tslib-conf \                                                                                                                                                                                               
    tslib-tests \                                                                                                                                                                                              
    tslib-calibrate \                                                                                                                                                                                          
    tslib \
"
```

## conf/layer.conf
```bitbake
# We have a conf and classes directory, add to BBPATH
BBPATH =. "${LAYERDIR}:"

# We have recipes-* directories, add to BBFILES
BBFILES += "${LAYERDIR}/recipes-*/*/*.bb \
            ${LAYERDIR}/recipes-*/*/*.bbappend"

REQUIRED_POKY_BBLAYERS_CONF_VERSION = "2"
```
